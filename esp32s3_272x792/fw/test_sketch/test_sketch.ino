// Desk-buddy CrowPanel 5.79" e-paper: weather test page.
//
// 1. Connects Wi-Fi using shared/net_config.h (generated from shared/net.env
//    by shared/tools/net_config.py — the SAME config the C6 firmware uses).
// 2. Fetches live weather from Open-Meteo over TLS (weather_rest_test).
// 3. Shows the pre-rendered weather bitmap (weatherimg.h, generated by
//    tools/render_weather.py); falls back to the net-status bitmap
//    (statusimg.h, from tools/render_status_page.py) if Wi-Fi is down.
// 4. Deep sleep (panel content persists on the e-ink).

#include <Arduino.h>
#include <WiFi.h>
#include <net_config.h>
#include "EPD.h"
#include "statusimg.h"
#include "weatherimg.h"
#include "mbedtls/ssl.h"
#include "mbedtls/net_sockets.h"
#include "mbedtls/x509_crt.h"
#include "mbedtls/error.h"
#include "esp_random.h"
#include "le_dercainfo.h"  // LE_ANCHORS: Let's Encrypt trust roots as DER (gen_le_dercainfo.py)

// Pin 7 = display power (LDO) enable, per Elecrow examples
#define EPD_PWR_PIN 7

uint8_t ImageBW[272 * 800 / 8];  // buffer: 800x272 (two cascaded SSD1683)

static bool wifi_up() {
  WiFi.mode(WIFI_STA);
  WiFi.setHostname("deskbuddy-s3");
  WiFi.begin(WIFI_SSID, WIFI_PSWD);
  uint32_t t0 = millis();
  while (WiFi.status() != WL_CONNECTED && millis() - t0 < 20000) delay(100);
  if (WiFi.status() != WL_CONNECTED) return false;
  Serial.printf("net: wifi up ssid=%s ip=%s rssi=%d mac=%s\n", WIFI_SSID,
                WiFi.localIP().toString().c_str(), WiFi.RSSI(),
                WiFi.macAddress().c_str());
  return true;
}

// Weather fetch over TLS using raw mbedTLS + DER trust anchors.
//
// WHY NOT WiFiClientSecure: this board's prebuilt esp32-arduino build has a PEM
// parser that rejects the Let's Encrypt chain (mbedtls_x509_crt_parse ->
// BAD_INPUT_DATA), so the Arduino wrapper's verified TLS can never connect.
// Its DER parser is fine, so we drive mbedTLS directly and feed DER trust
// anchors (LE_ANCHORS). Proven: handshake OK, verify flags 0x00000000, HTTP 200.
static int le_rng(void *p, unsigned char *out, size_t len) {
  (void)p; esp_fill_random(out, len); return 0;
}

static float num_after(const char *j, const char *key) {
  const char *p = strstr(j, key);
  if (!p) return NAN;
  while (*p && *p != ':') p++;
  if (!*p) return NAN;
  p++;
  while (*p == ' ' || *p == '\t') p++;
  if (!(*p == '-' || (*p >= '0' && *p <= '9') || *p == '.')) return NAN;
  return (float)atof(p);
}

static void weather_rest_test() {
  char path[210];
  snprintf(path, sizeof(path),
           "/v1/forecast?latitude=%s&longitude=%s"
           "&current=temperature_2m,apparent_temperature,precipitation,weather_code,wind_speed_10m"
           "&hourly=temperature_2m,weather_code&forecast_hours=13&timezone=auto",
           WEATHER_LAT, WEATHER_LON);
  char req[300];
  int ql = snprintf(req, sizeof(req), "GET %s HTTP/1.1\r\nHost: %s\r\n"
                "User-Agent: desk-buddy-s3\r\nConnection: close\r\n\r\n", path, WEATHER_HOST);
  if (ql < 0 || (size_t)ql >= sizeof(req)) { Serial.println("wx: request truncated"); return; }
  Serial.printf("wx: GET https://%s%s\n", WEATHER_HOST, path);

  mbedtls_net_context net; mbedtls_ssl_context ssl; mbedtls_ssl_config conf;
  mbedtls_x509_crt cacrt;
  mbedtls_net_init(&net); mbedtls_ssl_init(&ssl); mbedtls_ssl_config_init(&conf);
  mbedtls_x509_crt_init(&cacrt);

  int r = mbedtls_net_connect(&net, WEATHER_HOST, "443", MBEDTLS_NET_PROTO_TCP);
  if (r) { char b[80]; mbedtls_strerror(r, b, sizeof(b)); Serial.printf("wx: tcp FAIL (%s)\n", b); return; }

  mbedtls_ssl_config_defaults(&conf, MBEDTLS_SSL_IS_CLIENT, MBEDTLS_SSL_TRANSPORT_STREAM, NULL);
  mbedtls_ssl_conf_rng(&conf, le_rng, NULL);
  mbedtls_ssl_conf_authmode(&conf, MBEDTLS_SSL_VERIFY_REQUIRED);
  for (size_t i = 0; i < sizeof(LE_ANCHORS) / sizeof(LE_ANCHORS[0]); i++)
    mbedtls_x509_crt_parse_der(&cacrt, LE_ANCHORS[i].der, LE_ANCHORS[i].len);
  mbedtls_ssl_conf_ca_chain(&conf, &cacrt, NULL);
  mbedtls_ssl_setup(&ssl, &conf);
  mbedtls_ssl_set_hostname(&ssl, WEATHER_HOST);
  mbedtls_ssl_set_bio(&ssl, &net, mbedtls_net_send, mbedtls_net_recv, mbedtls_net_recv_timeout);

  int h = mbedtls_ssl_handshake(&ssl);
  if (h) { char b[160]; mbedtls_strerror(h, b, sizeof(b)); Serial.printf("wx: TLS FAIL r=%d (%s)\n", h, b); return; }
  Serial.printf("wx: TLS verified (flags 0x%08lx)\n", (unsigned long)mbedtls_ssl_get_verify_result(&ssl));

  if (mbedtls_ssl_write(&ssl, (const unsigned char *)req, (size_t)ql) < 0) {
    Serial.println("wx: request write FAIL"); return;
  }

  // read the full response (Connection: close -> server closes when done)
  static char body[4096];
  int n = 0; uint32_t t0 = millis(); bool closed = false;
  while (!closed && millis() - t0 < 15000) {
    int rc = mbedtls_ssl_read(&ssl, (unsigned char *)body + n, sizeof(body) - 1 - n);
    if (rc > 0) { n += rc; continue; }
    if (rc == MBEDTLS_ERR_SSL_WANT_READ) { delay(10); continue; }
    if (rc == MBEDTLS_ERR_SSL_PEER_CLOSE_NOTIFY || rc == MBEDTLS_ERR_NET_CONN_RESET) closed = true;
    else { Serial.printf("wx: read FAIL r=0x%04x\n", (unsigned)rc); break; }
  }
  body[n] = 0;
  char hdr[32]; sscanf(body, "%31s", hdr);
  int sc = 0; sscanf(body, "%*s %d", &sc);
  Serial.printf("wx: %d bytes in %lums (%s %d)\n", n, millis() - t0, hdr, sc);

  // strip HTTP headers -> body
  char *p = body;
  const char *hd = strstr(body, "\r\n\r\n");
  if (hd) p = (char *)(hd + 4);
  // de-chunk (Transfer-Encoding: chunked): <hexlen>\r\n<data>\r\n ... 0\r\n\r\n
  char *o = body; char *src = p;
  while (*src) {
    if (isxdigit((unsigned char)src[0])) {
      // parse hex chunk length on this line
      unsigned long len = 0;
      while (isxdigit((unsigned char)*src)) { len = len * 16 + (isdigit(*src) ? *src - '0' : *src - 'a' + 10); src++; }
      // skip the CRLF after the hex size
      if (*src == '\r') { src++; if (*src == '\n') src++; }
      if (len == 0) break;  // final chunk
      if ((unsigned long)(o - body) + len >= sizeof(body)) { *o = 0; break; }
      memcpy(o, src, len); o += len;
      src += len;
      // skip trailing CRLF
      if (*src == '\r') src++;
      if (*src == '\n') src++;
    } else {
      *o++ = *src++;  // non-chunked: copy raw
    }
  }
  *o = 0;
  int blen = o - body;
  (void)blen;

  // parse just the fields the panel needs (no JSON lib in this build)
  // anchor to "current":{" — current_units block has the same key names as strings
  const char *cblk = strstr(body, "\"current\":{");
  float cur   = cblk ? num_after(cblk, "\"temperature_2m\"") : NAN;
  float feels = cblk ? num_after(cblk, "\"apparent_temperature\"") : NAN;
  float wind  = cblk ? num_after(cblk, "\"wind_speed_10m\"") : NAN;
  int   code  = (int)(cblk ? num_after(cblk, "\"weather_code\"") : NAN);
  // hourly temp range (13h): anchor on the temperature_2m array inside "hourly"
  float lo = 999, hi = -999;
  const char *h0 = strstr(body, "\"hourly\"");
  const char *k = h0 ? strstr(h0, "\"temperature_2m\":[") : NULL;
  if (k) {
    const char *a = strchr(k, '[');
    const char *c = a ? a + 1 : NULL;
    const char *a1 = a ? strchr(a, ']') : NULL;
    while (c && c < a1) {
      if (*c == '-' || (*c >= '0' && *c <= '9')) {
        float v = (float)atof(c);
        if (v < lo) lo = v;
        if (v > hi) hi = v;
        // advance to just after the full number token, then past the delimiter
        const char *e = c;
        while (e < a1 && (*e == '-' || (*e >= '0' && *e <= '9') || *e == '.')) e++;
        c = e + 1;
      } else {
        c++;
      }
    }
  }
  Serial.printf("wx: OK now=%.1f feels=%.1f wind=%.1fkm/h code=%d range=%.1f..%.1f (13h)\n",
                cur, feels, wind, code, lo, hi);

  mbedtls_ssl_close_notify(&ssl);
  mbedtls_net_free(&net); mbedtls_ssl_free(&ssl); mbedtls_ssl_config_free(&conf); mbedtls_x509_crt_free(&cacrt);
}

void setup() {
  Serial.begin(115200);
  Serial.println();
  Serial.println("== desk-buddy 5.79 e-paper: weather test ==");

  pinMode(EPD_PWR_PIN, OUTPUT);
  digitalWrite(EPD_PWR_PIN, HIGH);
  delay(100);
  Serial.println("panel power: on");

  bool wifi = wifi_up();
  if (!wifi) Serial.println("net: wifi NOT connected (20s)");

  EPD_GPIOInit();
  Paint_NewImage(ImageBW, EPD_W, EPD_H, Rotation, WHITE);
  Paint_Clear(WHITE);

  Serial.print("init: ");
  EPD_FastMode1Init();
  EPD_Display_Clear();
  EPD_Update();
  Serial.println("blank full refresh done");

  // Only attempt the fetch if wifi came up; on failure show the net-status
  // fallback bitmap (API name + wifi glyph) rather than stale weather data.
  bool wxFetched = false;
  if (wifi) {
    weather_rest_test();
    wxFetched = true;
  }

  EPD_GPIOInit();
  EPD_FastMode1Init();
  EPD_ShowPicture(0, 0, 792, 272, wxFetched ? gImage_weather : gImage_status, WHITE);
  EPD_Display(ImageBW);
  EPD_FastUpdate();
  Serial.printf("panel up: %s shown (wifi=%d)\n",
                wxFetched ? "weather" : "net status", (int)wifi);

  EPD_DeepSleep();
  Serial.println("panel: deep sleep");
}

void loop() {
  // status firmware: do nothing
}
